SECTIONS
{
    __romPos = 0;
    header_ROM_START = __romPos;
    header_VRAM = ADDR(.header);
    .header : AT(header_ROM_START) SUBALIGN(16)
    {
        FILL(0x00000000);
        header_DATA_START = .;
        build/asm/header.s.o(.data);
        header_DATA_END = .;
        header_DATA_SIZE = ABSOLUTE(header_DATA_END - header_DATA_START);
    }
    __romPos += SIZEOF(.header);
    header_ROM_END = __romPos;
    header_VRAM_END = .;

    main_ROM_START = __romPos;
    main_VRAM = ADDR(.main);
    .main 0x80010000 : AT(main_ROM_START) SUBALIGN(16)
    {
        FILL(0x00000000);
        main_TEXT_START = .;
        build/asm/asm_start.s.o(.text);
        build/src/main/Engine_UpdateInputState.c.o(.text);
        build/asm/asm_16814.s.o(.text);
        build/asm/main/FUN_80028e10.s.o(.text);
        build/asm/asm_mid.s.o(.text);
        build/asm/main/FUN_800310f4.s.o(.text);
        build/asm/main/FUN_8003116c.s.o(.text);
        build/asm/main/FUN_800312d4.s.o(.text);
        build/asm/main/FUN_800313a0.s.o(.text);
        build/asm/main/FUN_80031470.s.o(.text);
        build/asm/main/FUN_80031558.s.o(.text);
        build/src/main/EntityLoop_Player.c.o(.text);
        build/asm/main/func_8003BF04_pad.s.o(.text);
        build/src/main/EntityLoop_Object.c.o(.text);
        build/src/main/EntityLoop_NPC.c.o(.text);
        build/src/main/EntityLoop_Background_Draw.c.o(.text);
        build/src/main/EntityLoop_Active.c.o(.text);
        build/src/main/Entity_Actions.c.o(.text);
        build/src/main/Engine_DispatchStateUpdate.c.o(.text);
        build/asm/main/func_8003D23C_asm.s.o(.text);
        build/src/main/Engine_HandleState.c.o(.text);
        build/asm/main/FUN_8003E030.s.o(.text);
        build/src/main/EntityLoop_Background.c.o(.text);
        build/src/main/Entity_UpdateMovement.c.o(.text);
        build/src/main/EntityFX_Update.c.o(.text);
        build/src/main/Engine_ExecuteGameLoop.c.o(.text);
        build/asm/main/FUN_8003FA1C.s.o(.text);
        build/src/main/GPU_ProcessRenderQueue.c.o(.text);
        build/asm/main/func_8004FE84_tail.s.o(.text);
        build/src/main/Entity_Allocator.c.o(.text);
        build/asm/asm_end.s.o(.text);
        . = ALIGN(., 16);
        main_TEXT_END = .;
        main_TEXT_SIZE = ABSOLUTE(main_TEXT_END - main_TEXT_START);
        main_DATA_START = .;
        build/asm/asm_start.s.o(.data);
        build/src/main/Engine_UpdateInputState.c.o(.data);
        build/asm/asm_16814.s.o(.data);
        build/asm/main/FUN_80028e10.s.o(.data);
        build/asm/asm_mid.s.o(.data);
        build/asm/main/FUN_800310f4.s.o(.data);
        build/asm/main/FUN_8003116c.s.o(.data);
        build/asm/main/FUN_800312d4.s.o(.data);
        build/asm/main/FUN_800313a0.s.o(.data);
        build/asm/main/FUN_80031470.s.o(.data);
        build/asm/main/FUN_80031558.s.o(.data);
        build/src/main/EntityLoop_Player.c.o(.data);
        build/asm/main/func_8003BF04_pad.s.o(.data);
        build/src/main/EntityLoop_Object.c.o(.data);
        build/src/main/EntityLoop_NPC.c.o(.data);
        build/src/main/EntityLoop_Background_Draw.c.o(.data);
        build/src/main/EntityLoop_Active.c.o(.data);
        build/src/main/Entity_Actions.c.o(.data);
        build/src/main/Engine_DispatchStateUpdate.c.o(.data);
        build/asm/main/func_8003D23C_asm.s.o(.data);
        build/src/main/Engine_HandleState.c.o(.data);
        build/asm/main/FUN_8003E030.s.o(.data);
        build/src/main/EntityLoop_Background.c.o(.data);
        build/src/main/Entity_UpdateMovement.c.o(.data);
        build/src/main/EntityFX_Update.c.o(.data);
        build/src/main/Engine_ExecuteGameLoop.c.o(.data);
        build/asm/main/FUN_8003FA1C.s.o(.data);
        build/src/main/GPU_ProcessRenderQueue.c.o(.data);
        build/asm/main/func_8004FE84_tail.s.o(.data);
        build/src/main/Entity_Allocator.c.o(.data);
        build/asm/asm_end.s.o(.data);
        . = ALIGN(., 16);
        main_DATA_END = .;
        main_DATA_SIZE = ABSOLUTE(main_DATA_END - main_DATA_START);
        main_RODATA_START = .;
        build/asm/asm_start.s.o(.rodata);
        build/src/main/Engine_UpdateInputState.c.o(.rodata);
        build/asm/asm_16814.s.o(.rodata);
        build/asm/main/FUN_80028e10.s.o(.rodata);
        build/asm/asm_mid.s.o(.rodata);
        build/asm/main/FUN_800310f4.s.o(.rodata);
        build/asm/main/FUN_8003116c.s.o(.rodata);
        build/asm/main/FUN_800312d4.s.o(.rodata);
        build/asm/main/FUN_800313a0.s.o(.rodata);
        build/asm/main/FUN_80031470.s.o(.rodata);
        build/asm/main/FUN_80031558.s.o(.rodata);
        build/src/main/EntityLoop_Player.c.o(.rodata);
        build/asm/main/func_8003BF04_pad.s.o(.rodata);
        build/src/main/EntityLoop_Object.c.o(.rodata);
        build/src/main/EntityLoop_NPC.c.o(.rodata);
        build/src/main/EntityLoop_Background_Draw.c.o(.rodata);
        build/src/main/EntityLoop_Active.c.o(.rodata);
        build/src/main/Entity_Actions.c.o(.rodata);
        build/src/main/Engine_DispatchStateUpdate.c.o(.rodata);
        build/asm/main/func_8003D23C_asm.s.o(.rodata);
        build/src/main/Engine_HandleState.c.o(.rodata);
        build/asm/main/FUN_8003E030.s.o(.rodata);
        build/src/main/EntityLoop_Background.c.o(.rodata);
        build/src/main/Entity_UpdateMovement.c.o(.rodata);
        build/src/main/EntityFX_Update.c.o(.rodata);
        build/src/main/Engine_ExecuteGameLoop.c.o(.rodata);
        build/asm/main/FUN_8003FA1C.s.o(.rodata);
        build/src/main/GPU_ProcessRenderQueue.c.o(.rodata);
        build/asm/main/func_8004FE84_tail.s.o(.rodata);
        build/src/main/Entity_Allocator.c.o(.rodata);
        build/asm/asm_end.s.o(.rodata);
        . = ALIGN(., 16);
        main_RODATA_END = .;
        main_RODATA_SIZE = ABSOLUTE(main_RODATA_END - main_RODATA_START);
        main_BSS_START = .;
        build/asm/asm_start.s.o(.bss);
        build/src/main/Engine_UpdateInputState.c.o(.bss);
        build/asm/asm_16814.s.o(.bss);
        build/asm/main/FUN_80028e10.s.o(.bss);
        build/asm/asm_mid.s.o(.bss);
        build/asm/main/FUN_800310f4.s.o(.bss);
        build/asm/main/FUN_8003116c.s.o(.bss);
        build/asm/main/FUN_800312d4.s.o(.bss);
        build/asm/main/FUN_800313a0.s.o(.bss);
        build/asm/main/FUN_80031470.s.o(.bss);
        build/asm/main/FUN_80031558.s.o(.bss);
        build/src/main/EntityLoop_Player.c.o(.bss);
        build/asm/main/func_8003BF04_pad.s.o(.bss);
        build/src/main/EntityLoop_Object.c.o(.bss);
        build/src/main/EntityLoop_NPC.c.o(.bss);
        build/src/main/EntityLoop_Background_Draw.c.o(.bss);
        build/src/main/EntityLoop_Active.c.o(.bss);
        build/src/main/Entity_Actions.c.o(.bss);
        build/src/main/Engine_DispatchStateUpdate.c.o(.bss);
        build/asm/main/func_8003D23C_asm.s.o(.bss);
        build/src/main/Engine_HandleState.c.o(.bss);
        build/asm/main/FUN_8003E030.s.o(.bss);
        build/src/main/EntityLoop_Background.c.o(.bss);
        build/src/main/Entity_UpdateMovement.c.o(.bss);
        build/src/main/EntityFX_Update.c.o(.bss);
        build/src/main/Engine_ExecuteGameLoop.c.o(.bss);
        build/asm/main/FUN_8003FA1C.s.o(.bss);
        build/src/main/GPU_ProcessRenderQueue.c.o(.bss);
        build/asm/main/func_8004FE84_tail.s.o(.bss);
        build/src/main/Entity_Allocator.c.o(.bss);
        build/asm/asm_end.s.o(.bss);
        . = ALIGN(., 16);
        main_BSS_END = .;
        main_BSS_SIZE = ABSOLUTE(main_BSS_END - main_BSS_START);
    }
    __romPos += SIZEOF(.main);
    __romPos = ALIGN(__romPos, 16);
    . = ALIGN(., 16);
    main_ROM_END = __romPos;
    main_VRAM_END = .;

    /DISCARD/ :
    {
        *(*);
    }
}
